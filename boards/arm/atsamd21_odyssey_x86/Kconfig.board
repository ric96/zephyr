## boards/arm/atsamd21_odyssey_x86/Kconfig.board
```kconfig
# SAM D21 Odyssey x86 board configuration

# Copyright (c) 2022 Linaro Limited
# SPDX-License-Identifier: Apache-2.0

config BOARD_ATSAMD21_ODYSSEY_X86
	bool "SAM D21 Odyssey X86"
	depends on SOC_PART_NUMBER_SAMD21J18A
```

## boards/arm/atsamd21_odyssey_x86/Kconfig.defconfig
```kconfig
# SAM D21 Odyssey x86 board configuration

# Copyright (c) 2022 Linaro Limited
# SPDX-License-Identifier: Apache-2.0

config BOARD
	default "atsamd21_odyssey_x86"
	depends on BOARD_ATSAMD21_ODYSSEY_X86
```
